## conf/distro/tis-x.conf
```bitbake
# The Imaging Source Distro for Wayland with XWayland.
# Using the upstream kernel flavour.

require conf/distro/include/tdx-base.inc

DISTRO = "tis-x"
DISTRO_NAME = "TIS Wayland with X11"
DISTROOVERRIDES .= ":upstream"
DISTRO_FLAVOUR = " (UPSTREAM)"
IMAGE_BASENAME:append = "-upstream"

IMX_DEFAULT_BSP = "mainline"

# we use graphics, so set opengl
DISTRO_FEATURES:append = " opengl egl"

DISTRO_FEATURES:append = " x11"

DISTRO_FEATURES:append = " usrmerge"

DISTRO_FEATURES:append = " virtualization"

# lxqt requires this
DISTRO_FEATURES:append = " polkit"
```

## conf/distro/tis-xwayland.conf
```bitbake
# The Imaging Source Distro for Wayland with XWayland.
# Using the upstream kernel flavour.

require conf/distro/include/tdx-base.inc

DISTRO = "tis-xwayland"
DISTRO_NAME = "TIS Wayland with XWayland"
DISTROOVERRIDES .= ":upstream"
DISTRO_FLAVOUR = " (UPSTREAM)"
IMAGE_BASENAME:append = "-upstream"

IMX_DEFAULT_BSP = "mainline"

# we use graphics, so set opengl
DISTRO_FEATURES:append = " opengl egl wayland-egl"

DISTRO_FEATURES:append = " wayland x11"

DISTRO_FEATURES:append = " usrmerge"

# lxqt requires this
DISTRO_FEATURES:append = " polkit"
```
